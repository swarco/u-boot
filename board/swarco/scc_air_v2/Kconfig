## board/swarco/scc_air_v2/Kconfig
```kconfig
if TARGET_SCC_AIR_V2

config SYS_BOARD
	default "scc_air_v2"

config SYS_VENDOR
	default "swarco"

config SYS_CONFIG_NAME
	default "scc_air_v2"

endif
```
